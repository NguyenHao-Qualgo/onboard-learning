## kas/layers/meta-edk2/conf/layer.conf
```bitbake
# We have a conf and classes directory, add to BBPATH
BBPATH .= ":${LAYERDIR}"

# We have recipes-* directories, add to BBFILES
BBFILES += "${LAYERDIR}/recipes-*/*/*.bb \
            ${LAYERDIR}/recipes-*/*/*.bbappend"

BBFILE_COLLECTIONS += "meta-edk2"
BBFILE_PATTERN_meta-edk2 = "^${LAYERDIR}/"
BBFILE_PRIORITY_meta-edk2 = "6"

LAYERDEPENDS_meta-edk2 = "core"
LAYERSERIES_COMPAT_meta-edk2 = "scarthgap"
```

## kas/layers/meta-skytrack-kernel/conf/layer.conf
```bitbake
# We have a conf and classes directory, add to BBPATH
BBPATH .= ":${LAYERDIR}"

# We have recipes-* directories, add to BBFILES
BBFILES += "${LAYERDIR}/recipes-*/*/*.bb \
            ${LAYERDIR}/recipes-*/*/*.bbappend"

BBFILE_COLLECTIONS += "meta-qualgo-kernel"
BBFILE_PATTERN_meta-qualgo-kernel = "^${LAYERDIR}/"
BBFILE_PRIORITY_meta-qualgo-kernel = "6"

LAYERSERIES_COMPAT_meta-qualgo-kernel = "kirkstone mickledore scarthgap"
# LAYERDEPENDS_meta-qualgo-kernel = "core"
# LAYERSERIES_COMPAT_meta-qualgo-kernel = "scarthgap"
```

## kas/layers/meta-skytrack-secureboot/conf/distro/qualgo.conf
```bitbake
require conf/distro/tegrademo.conf

QUALGO_BOOTFLOW ?= "autoenroll"
OVERRIDES:append = ":bootflow-${QUALGO_BOOTFLOW}"

TEGRA_UEFI_USE_SIGNED_FILES:bootflow-nvidia = "true"
EFI_PROVIDER:bootflow-nvidia = "edk2-bootloader-firmware"

IMAGE_INSTALL:bootflow-autoenroll:append = " edk2-bootloader-firmware"
```

## kas/layers/meta-skytrack-secureboot/conf/layer.conf
```bitbake
# We have a conf and classes directory, add to BBPATH
BBPATH .= ":${LAYERDIR}"

# We have recipes-* directories, add to BBFILES
BBFILES += "${LAYERDIR}/recipes-*/*/*.bb \
            ${LAYERDIR}/recipes-*/*/*.bbappend \
            ${LAYERDIR}/recipes-*/*/*/*.bb \
            ${LAYERDIR}/recipes-*/*/*/*.bbappend"

BBFILE_COLLECTIONS += "meta-qualgo-secureboot"
BBFILE_PATTERN_meta-qualgo-secureboot = "^${LAYERDIR}/"
BBFILE_PRIORITY_meta-qualgo-secureboot = "6"

LAYERDEPENDS_meta-qualgo-secureboot = "core"
LAYERSERIES_COMPAT_meta-qualgo-secureboot = "scarthgap"
```
